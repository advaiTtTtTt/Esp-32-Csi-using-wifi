## firmware/receiver/main/Kconfig.projbuild
```kconfig
menu "Wi-Fi Radar"

config RADAR_RSSI_FALLBACK
    bool "Build RSSI-only receiver fallback"
    default n
    help
        Enable this if CSI capture fails on the configured ESP32-WROOM-32 build.
        Movement sensing then uses RSSI and is less sensitive.

endmenu
```

## firmware/transmitter/sdkconfig.defaults
```kconfig
CONFIG_ESP_CONSOLE_UART_DEFAULT=y
CONFIG_ESP_CONSOLE_UART_BAUDRATE=115200
CONFIG_LOG_DEFAULT_LEVEL_INFO=y
```
